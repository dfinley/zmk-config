## config/west.yml
```yaml
manifest:
  remotes:
    - name: zmkfirmware
      url-base: https://github.com/zmkfirmware
    - name: dhruvinsh
      url-base: https://github.com/dhruvinsh
    - name: rolio
      url-base: https://github.com/Townk
    - name: m165437
      url-base: https://github.com/M165437
  projects:
    - name: zmk
      remote: zmkfirmware
      revision: main
      clone-depth: 1
      import: app/west.yml
    - name: zmk-tri-state
      remote: dhruvinsh
      revision: main
      clone-depth: 1
      path: modules/zmk-tri-state
    - name: zmk-rolio-shield
      remote: rolio
      revision: develop
      clone-depth: 1
      path: modules/zmk-rolio-shield
    - name: nice-view-gem
      remote: m165437
      revision: main
      clone-depth: 1
      path: modules/nice-view-gem
  self:
    path: config
```
